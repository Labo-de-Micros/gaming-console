//////////////////////////////////////////////////////////////////
//////////////////////////////////////////////////////////////////
//							Headers								//
//////////////////////////////////////////////////////////////////
//////////////////////////////////////////////////////////////////

#include "./Drivers/Timer/timer.h"
#include "./Drivers/Accelerometer/FXOS8700CQ.h"
#include "./Drivers/ADC/ADC.h"
#include "./Drivers/MC74HC589A/MC74HC589A.h"
#include "./Drivers/UART/uart.h"

//////////////////////////////////////////////////////////////////
//////////////////////////////////////////////////////////////////
//		CONSTANT AND MACRO DEFINITIONS USING #DEFINE 		 	//
//////////////////////////////////////////////////////////////////
//////////////////////////////////////////////////////////////////


//////////////////////////////////////////////////////////////////
//////////////////////////////////////////////////////////////////
//			ENUMERATIONS AND STRUCTURES AND TYPEDEFS	  		//
//////////////////////////////////////////////////////////////////
//////////////////////////////////////////////////////////////////

//////////////////////////////////////////////////////////////////
//////////////////////////////////////////////////////////////////
//						STATIC VARIABLES						//
//////////////////////////////////////////////////////////////////
//////////////////////////////////////////////////////////////////

////////////////////////////////////////////////////////////////
////////////////////////////////////////////////////////////////
//FUNCTION PROTOTYPES FOR PRIVATE FUNCTIONS W FILE LEVEL SCOPE//
////////////////////////////////////////////////////////////////
////////////////////////////////////////////////////////////////

static void get_data(void);
static void event_generator(void);

//////////////////////////////////////////////////////////////////
//////////////////////////////////////////////////////////////////
//					FUNCTION DEFINITIONS						//
//////////////////////////////////////////////////////////////////
//////////////////////////////////////////////////////////////////

void App_Init (void){
    FXOS8700CQ_init(HYBRID_200);
    ADC_init();
    MC74HC589A_init();
    uart_cfg_t uart_test;
 	uart_test.baudrate = 9600;
 	uart_init(UART_3, uart_test);
	return;
}

void App_Run (void){
    while(true){
        event_generator();
        timerDelay(TIMER_MS2TICKS(100));
        get_data();
    }
	return;
}

//////////////////////////////////////////////////////////////////
//////////////////////////////////////////////////////////////////
//					LOCAL FUNCTION DEFINITIONS					//
//////////////////////////////////////////////////////////////////
//////////////////////////////////////////////////////////////////

static void event_generator(void){
    if(!ADC_is_converting())
        ADC_start_conversion();
    MC74HC589A_latch_data();
    return;
}

static void get_data(void){
    uint16_t adc;
    uint8_t shift;
    uint8_t llegada;
    FXOS8700CQ_raw_data_t accel;
    if(!ADC_is_converting())
        adc = ADC_get_data();
    shift = MC74HC589A_get_data();
    accel = FXOS8700CQ_get_data(ACCELEROMETER_DATA);
    if(download_word(1))
        llegada = get_word_down_ptr()[0];
    return;
}
